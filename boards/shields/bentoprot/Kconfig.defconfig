## boards/shields/bentoprot/Kconfig.defconfig
```kconfig
if SHIELD_BENTOPROT_RIGHT

config ZMK_KEYBOARD_NAME
    default "bentoprot"

endif

if SHIELD_BENTOPROT_LEFT || SHIELD_BENTOPROT_RIGHT

config ZMK_SPLIT
    default y

endif
```

## boards/shields/bentoprot/Kconfig.shield
```kconfig
config SHIELD_BENTOPROT_LEFT
    def_bool $(shields_list_contains,bentoprot_left)
config SHIELD_BENTOPROT_RIGHT
    def_bool $(shields_list_contains,bentoprot_right)
```
